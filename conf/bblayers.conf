## conf/bblayers.conf
```bitbake
# LAYER_CONF_VERSION is increased each time build/conf/bblayers.conf
# changes incompatibly
LCONF_VERSION = "5"
TOPDIR := "${@os.path.dirname(os.path.dirname(d.getVar('FILE', True)))}"

BBPATH = "${TOPDIR}"

BBFILES = ""

# These layers hold recipe metadata not found in OE-core, but lack any machine or distro content
BASELAYERS ?= " \
  ${TOPDIR}/sources/meta-openembedded/meta-oe \
  ${TOPDIR}/sources/meta-openembedded/meta-initramfs \
  ${TOPDIR}/sources/meta-openembedded/toolchain-layer \
  ${TOPDIR}/sources/meta-openembedded/meta-networking \
  ${TOPDIR}/sources/meta-openembedded/meta-filesystems \
  ${TOPDIR}/sources/meta-openembedded/meta-perl \
  ${TOPDIR}/sources/meta-openembedded/meta-python \
  ${TOPDIR}/sources/meta-openembedded/meta-systemd \
"

# These layers hold machine specific content, aka Board Support Packages
BSPLAYERS ?= " \
  ${TOPDIR}/sources/meta-sunxi \
"

# Add your overlay location to EXTRALAYERS
# Make sure to have a conf/layers.conf in there
EXTRALAYERS ?= " \
  ${TOPDIR}/sources/meta-linaro/meta-linaro-toolchain \
  ${TOPDIR}/sources/meta-tuxy/ \
"

BBLAYERS = " \
  ${BASELAYERS} \
  ${BSPLAYERS} \
  ${EXTRALAYERS} \
  ${TOPDIR}/sources/openembedded-core/meta \
  "
```

## conf/local.conf
```bitbake
CONF_VERSION = "1"
DL_DIR = "${OEBASE}/downloads"
SSTATE_DIR = "${OEBASE}/build/sstate-cache"
TMPDIR = "${OEBASE}/build/tmp"
PERSISTENT_DIR = "${OEBASE}/build/cache"
DEPLOY_DIR = "${OEBASE}/build/deploy"
DEPLOY_DIR_IMAGE = "${DEPLOY_DIR}/images/${DISTRO}-${MACHINE}"

# tmpdir is build/tmp, not build/tmp-glibc
TCLIBCAPPEND = ""

# generate sunxi SD card image
IMAGE_FSTYPES = "tar.gz sunxi-sdimg"

#INHERIT += "rm_work"

# Disable ISO image by default
NOISO = "1"

# Make use of SMP:
#   PARALLEL_MAKE specifies how many concurrent compiler threads are spawned per bitbake process
#   BB_NUMBER_THREADS specifies how many concurrent bitbake tasks will be run
PARALLEL_MAKE     = "-j${CORE_COUNT}"
BB_NUMBER_THREADS = "${CORE_COUNT}"

# Don't generate the mirror tarball for SCM repos, the snapshot is enough
BB_GENERATE_MIRROR_TARBALLS = "0"

# Disable build time patch resolution. This would lauch a devshell
# and wait for manual intervention. We disable it.
PATCHRESOLVE = "noop"

# enable PR service on build machine itself
# its good for a case when this is the only builder
# generating the feeds
PRSERV_HOST = "localhost:0"
```
